## configs/tag_defconfig
```kconfig
CONFIG_CROSS_COMPILE="arm-none-eabi-"

CONFIG_ESTIMATOR=any
CONFIG_CONTROLLER=Any
CONFIG_POWER_DISTRIBUTION=stock

CONFIG_DECK_FORCE=bcDWM1000
CONFIG_SENSORS_IGNORE_BAROMETER_FAIL=y

CONFIG_SENSORS_BMI088_BMP388=y
CONFIG_SENSORS_BMI088_I2C=y
# CONFIG_SENSORS_MPU9250_LPS25H is not set
# CONFIG SENSORS_BMI088_SPI is not set
```
